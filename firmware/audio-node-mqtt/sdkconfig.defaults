## firmware/e1-breadboard/sdkconfig.defaults
```kconfig
# 这块板是 ESP32-S3-WROOM-1 N16R8：16MB Flash + 8MB Octal PSRAM。
CONFIG_IDF_TARGET="esp32s3"

# ---- Flash ----
CONFIG_ESPTOOLPY_FLASHSIZE_16MB=y
CONFIG_ESPTOOLPY_FLASHSIZE="16MB"
CONFIG_PARTITION_TABLE_SINGLE_APP_LARGE=y

# ---- PSRAM：N16R8 是 OCT，必须 8 线 ----
CONFIG_SPIRAM=y
CONFIG_SPIRAM_MODE_OCT=y
CONFIG_SPIRAM_SPEED_80M=y
CONFIG_SPIRAM_USE_MALLOC=y
CONFIG_SPIRAM_TRY_ALLOCATE_WIFI_LWIP=y

# ---- CPU ----
CONFIG_ESP_DEFAULT_CPU_FREQ_MHZ_240=y

# ---- Wi-Fi 缓冲：推流时留点余量 ----
CONFIG_ESP_WIFI_STATIC_RX_BUFFER_NUM=16
CONFIG_ESP_WIFI_DYNAMIC_RX_BUFFER_NUM=64
CONFIG_ESP_WIFI_TX_BUFFER_TYPE=1
CONFIG_ESP_WIFI_DYNAMIC_TX_BUFFER_NUM=64
CONFIG_LWIP_TCPIP_RECVMBOX_SIZE=64
CONFIG_LWIP_UDP_RECVMBOX_SIZE=64

# ---- 日志 ----
CONFIG_LOG_DEFAULT_LEVEL_INFO=y
CONFIG_LWIP_TCP_SND_BUF_DEFAULT=32768
CONFIG_LWIP_TCP_WND_DEFAULT=32768
CONFIG_LWIP_TCP_RECVMBOX_SIZE=64
CONFIG_MQTT_TASK_STACK_SIZE=6144
CONFIG_TCP_SND_BUF_DEFAULT=32768
CONFIG_TCP_WND_DEFAULT=32768
```
